## app/src/applications/settings/Kconfig
```kconfig
menu "Settings"
    module = TAT_SETTINGS_APP
    module-str = TAT_SETTINGS_APP
    source "subsys/logging/Kconfig.template.log_config"
endmenu
```

## app/src/ui/Kconfig
```kconfig
menu "UI"
    menu "UI Controller"
        module = TAT_UI
        module-str = TAT_UI
        source "subsys/logging/Kconfig.template.log_config"
    endmenu
endmenu
```

## drivers/sensor/stcc4/Kconfig
```kconfig
menuconfig TAT_STCC4
    bool "Sensirion STCC4 Sensor"
    depends on DT_HAS_TAT_STCC4_ENABLED
    default y
    select I2C
    help
      Enable the driver for the STCC4 CO2 sensor.

if TAT_STCC4
    config TAT_STCC4_EMUL
        bool "Emulate a Sensirion STCC4 CO2 sensor"
        default y
        depends on EMUL
        depends on TAT_STCC4
        help
          This is an emulator for the Sensirion STCC4 CO2 sensor.

    module = TAT_SENSIRION_STCC4
    module-str = TAT_SENSIRION_STCC4
    source "subsys/logging/Kconfig.template.log_config"

endif
```

## west.yml
```yaml
manifest:
  self:
    path: tat
  remotes:
    - name: nrf
      url-base: https://github.com/nrfconnect
  projects:
    - name: sdk-nrf
      remote: nrf
      path: nrf
      revision: v3.2.4
      import:
        path-prefix: external
      clone-depth: 1
```
